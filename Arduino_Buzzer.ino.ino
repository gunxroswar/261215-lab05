#include<Arduino.h>
#define buzzer1 21
#define buzzer2 22
#define button 19

int buzzer1Frequency[] = {277, 311, 262, 311, 277, 330, 311, 370, 554, 370, 415, 277, 554,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 740, 988};
int buzzer1Duration[] = {1302, 1302, 1302, 1302, 1302, 1302, 1302, 1302, 162, 162, 162, 0, 162,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 1280, 1234};
int buzzer2Frequency[] = {139, 208, 104, 156, 110, 165, 123, 185, 139, 208, 277, 104, 156,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 62, 123};
int buzzer2Duration[] = {1302, 1302, 1302, 1302, 1302, 1302, 1302, 1302, 1302, 1302, 1302, 1302, 1302,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 651, 651};
hw_timer_t *timer0 = NULL;
hw_timer_t *timer1 = NULL;
hw_timer_t *timer2 = NULL;
hw_timer_t *timer3 = NULL;
bool buzzer1On = false;
bool buzzer2On = false;
int track1Index = 0;
int track2Index = 0;
float speedMultiplayer = 1.0;
bool track1Next = true;
bool track2Next = true;
int stage = 1;
bool buttonPress = false;
unsigned long lastPress = 0;

void IRAM_ATTR IO_INT_ISR() { buttonPress = true; }
 

// This is the Timer ISR. It is automatically called 
// on a timer alarm event.
void IRAM_ATTR onTimer0(){
  if(buzzer1On) digitalWrite(buzzer1, LOW);
  else digitalWrite(buzzer1, HIGH);
  buzzer1On = !buzzer1On;
}

void IRAM_ATTR onTimer1(){ track1Next = true; }

void IRAM_ATTR onTimer2(){
  if(buzzer2On) digitalWrite(buzzer2, LOW);
  else digitalWrite(buzzer2, HIGH);
  buzzer2On = !buzzer2On;
}

void IRAM_ATTR onTimer3(){ track2Next = true; }

void setSpeed(){
  buttonPress = false;
  if(millis() < lastPress) return;
   switch(stage){
     case 1: speedMultiplayer = 0.5; break;
     case 2: speedMultiplayer = 1.0; break;
     case 3: speedMultiplayer = 1.5; break;
     case 4: speedMultiplayer = 2.0; break;
     case 5: speedMultiplayer = 0.25; break;
   }
   stage++;
   if(stage > 5) stage = 1;
   Serial.printf("stage: %d\n", stage);
   lastPress = millis()+500;
}

void setup(){
  Serial.begin(115200);
  pinMode(buzzer1, OUTPUT);
  pinMode(buzzer2, OUTPUT);
  pinMode(button, INPUT);
  digitalWrite(buzzer1, HIGH);
  digitalWrite(buzzer2, HIGH);
  attachInterrupt(button, IO_INT_ISR, RISING);
  timer0 = timerBegin(0, 80, true);
  timer1 = timerBegin(1, 80, true);
  timer2 = timerBegin(2, 80, true);
  timer3 = timerBegin(3, 80, true);
  timerAttachInterrupt(timer0, &onTimer0, true);
  timerAttachInterrupt(timer1, &onTimer1, true);
  timerAttachInterrupt(timer2, &onTimer2, true);
  timerAttachInterrupt(timer3, &onTimer3, true);
 
  timerAlarmWrite(timer0, 1000000/buzzer1Frequency[0], true);
  timerAlarmWrite(timer1, 1000000/buzzer1Duration[0], true);
  timerAlarmWrite(timer2, 1000000/buzzer2Frequency[0], true);
  timerAlarmWrite(timer3, 1000000/buzzer2Duration[0], true);

  timerAlarmEnable(timer0);
  timerAlarmEnable(timer1);
  timerAlarmEnable(timer2);
  timerAlarmEnable(timer3);
}

void loop(){
  if(buttonPress) setSpeed();
  if(track1Next){
    if(track1Index < 1286) track1Index++;
    else{
      digitalWrite(buzzer1, LOW);
      timerAlarmDisable(timer0);
      timerAlarmDisable(timer1);
    }
    if(buzzer1Frequency[track1Index] < 1) buzzer1Frequency[track1Index] = 1;
    if(buzzer1Duration[track1Index] < 1) buzzer1Duration[track1Index] = 1;
    timerAlarmWrite(timer0, (500000.0*speedMultiplayer)/(buzzer1Frequency[track1Index]), true);
    timerAlarmWrite(timer1, ((buzzer1Duration[track1Index]*1000)*speedMultiplayer), true);
    Serial.printf("T1: %d\n", track1Index);
    track1Next = false;
  }
  if(track2Next){
    if(track2Index < 1879) track2Index++;
    else{
      digitalWrite(buzzer2, LOW);
      timerAlarmDisable(timer2);
      timerAlarmDisable(timer3);
    }
    if(buzzer2Frequency[track2Index] < 1) buzzer2Frequency[track2Index] = 1;
    if(buzzer2Duration[track2Index] < 1) buzzer2Duration[track2Index] = 1;
    timerAlarmWrite(timer2, (500000.0*speedMultiplayer)/(buzzer2Frequency[track2Index]), true);
    timerAlarmWrite(timer3, ((buzzer2Duration[track2Index]*1000)*speedMultiplayer), true);
    Serial.printf("T2: %d\n", track2Index);
    track2Next = false;
  }
}
